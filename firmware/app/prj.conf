## CMakeLists.txt
```
cmake_minimum_required(VERSION 3.20.0)

find_package(Zephyr REQUIRED HINTS $ENV{ZEPHYR_BASE})
project(dot_ferry_app)

target_sources(app PRIVATE src/main.c)
```

## sysbuild.conf
```
# Build MCUboot alongside the app. The board's static partition map
# (forced by the board's sysbuild.cmake: mcuboot at 0x0, image at 0x10000)
# requires a bootloader; without one the app never boots.
SB_CONFIG_BOOTLOADER_MCUBOOT=y

# No signing key: MCUboot only checks the image hash, not a signature.
# Switch to a real signature type + key before shipping OTA updates.
SB_CONFIG_BOOT_SIGNATURE_TYPE_NONE=y
```

## prj.conf
```kconfig
# Console on uart0 (USB COM port via the on-board RP2040), 115200 8N1.
# Logs also go to SEGGER RTT (read with `probe-rs attach`) as a backup.
CONFIG_SERIAL=y
CONFIG_CONSOLE=y
CONFIG_UART_CONSOLE=y
CONFIG_LOG=y
CONFIG_LOG_BACKEND_UART=y
CONFIG_USE_SEGGER_RTT=y
CONFIG_LOG_BACKEND_RTT=y

# GPIO for the on-board LED
CONFIG_GPIO=y
```

## src/main.c
```c
/*
 * DOT Ferry Project - nRF9151 Feather firmware
 *
 * Starter app: prints a heartbeat over the USB serial console and
 * blinks the on-board LED (devicetree alias led0) if present.
 */

#include <zephyr/kernel.h>
#include <zephyr/drivers/gpio.h>
#include <zephyr/logging/log.h>

LOG_MODULE_REGISTER(app, LOG_LEVEL_INF);

#define BLINK_MS 1000

#if DT_NODE_HAS_STATUS(DT_ALIAS(led0), okay)
static const struct gpio_dt_spec led = GPIO_DT_SPEC_GET(DT_ALIAS(led0), gpios);
#define HAVE_LED 1
#else
#define HAVE_LED 0
#endif

int main(void)
{
	LOG_INF("DOT Ferry firmware starting on %s", CONFIG_BOARD);

#if HAVE_LED
	if (!gpio_is_ready_dt(&led) ||
	    gpio_pin_configure_dt(&led, GPIO_OUTPUT_INACTIVE) < 0) {
		LOG_ERR("LED init failed");
	}
#endif

	uint32_t count = 0;

	while (1) {
#if HAVE_LED
		gpio_pin_toggle_dt(&led);
#endif
		LOG_INF("heartbeat %u", count++);
		k_msleep(BLINK_MS);
	}

	return 0;
}
```
